/* Copyright (c) 2015, The Linux Foundation. All rights reserved.
 *
 * This program is free software; you can redistribute it and/or modify
 * it under the terms of the GNU General Public License version 2 and
 * only version 2 as published by the Free Software Foundation.
 *
 * This program is distributed in the hope that it will be useful,
 * but WITHOUT ANY WARRANTY; without even the implied warranty of
 * MERCHANTABILITY or FITNESS FOR A PARTICULAR PURPOSE.  See the
 * GNU General Public License for more details.
 */

&mdss_mdp {
	mdss_dsi_nt35521s_wxga_video: qcom,mdss_dsi_nt35521s_wxga_video {
		qcom,mdss-dsi-panel-name = "nt35521s wxga video mode dsi panel";
		qcom,mdss-dsi-panel-controller = <&mdss_dsi0>;
		qcom,mdss-dsi-panel-type = "dsi_video_mode";
		qcom,mdss-dsi-panel-destination = "display_1";
		qcom,mdss-dsi-panel-framerate = <60>;
		qcom,mdss-dsi-virtual-channel-id = <0>;
		qcom,mdss-dsi-stream = <0>;
		qcom,mdss-dsi-panel-width = <800>;
		qcom,mdss-dsi-panel-height = <1280>;
		qcom,mdss-dsi-h-front-porch = <0x50>;
		qcom,mdss-dsi-h-back-porch = <0x50>;
		qcom,mdss-dsi-h-pulse-width = <0x04>;
		qcom,mdss-dsi-h-sync-skew = <0x00>;
		qcom,mdss-dsi-v-back-porch = <0x10>;
		qcom,mdss-dsi-v-front-porch = <0x14>;
		qcom,mdss-dsi-v-pulse-width = <0x04>;
		qcom,mdss-dsi-h-left-border = <0x00>;
		qcom,mdss-dsi-h-right-border = <0x00>;
		qcom,mdss-dsi-v-top-border = <0x00>;
		qcom,mdss-dsi-v-bottom-border = <0x00>;
		qcom,mdss-dsi-bpp = <0x18>;
		qcom,mdss-dsi-color-order = "rgb_swap_rgb";
		qcom,mdss-dsi-underflow-color = <0xff>;
		qcom,mdss-dsi-border-color = <0x00>;
		qcom,mdss-dsi-pixel-packing = "tight";
		qcom,mdss-dsi-pixel-alignment = <0x00>;
		qcom,mdss-dsi-on-command = [
			29 01 00 00 00 00 06 f0 55 aa 52 08 00 
			29 01 00 00 00 00 03 b1 68 07 
			29 01 00 00 00 00 02 b6 08 
			29 01 00 00 00 00 02 6f 02 
			29 01 00 00 00 00 02 b8 08 
			29 01 00 00 00 00 03 bb 54 44 
			29 01 00 00 00 00 03 bc 05 05 
			29 01 00 00 00 00 02 c7 01 
			29 01 00 00 00 00 06 bd 02 b0 1e 1e 00 
			29 01 00 00 00 00 03 c5 01 07 
			29 01 00 00 00 00 02 c8 83 
			29 01 00 00 00 00 06 f0 55 aa 52 08 01 
			29 01 00 00 00 00 03 b0 05 05 
			29 01 00 00 00 00 03 b1 05 05 
			29 01 00 00 00 00 03 bc 90 01 
			29 01 00 00 00 00 03 bd 90 01 
			29 01 00 00 00 00 02 ca 00 
			29 01 00 00 00 00 02 c0 04 
			29 01 00 00 00 00 03 b3 28 28 
			29 01 00 00 00 00 03 b4 12 12 
			29 01 00 00 00 00 03 b9 45 45 
			29 01 00 00 00 00 03 ba 14 14 
			29 01 00 00 00 00 06 f0 55 aa 52 08 02 
			29 01 00 00 00 00 02 ee 01 
			29 01 00 00 00 00 05 ef 09 06 15 18 
			29 01 00 00 00 00 07 b0 00 00 00 0f 00 28 
			29 01 00 00 00 00 02 6f 06 
			29 01 00 00 00 00 07 b0 00 47 00 58 00 76 
			29 01 00 00 00 00 02 6f 0c 
			29 01 00 00 00 00 05 b0 00 9b 00 cd 
			29 01 00 00 00 00 07 b1 00 fc 01 3e 01 7c 
			29 01 00 00 00 00 02 6f 06 
			29 01 00 00 00 00 07 b1 01 d3 02 1a 02 1c 
			29 01 00 00 00 00 02 6f 0c 
			29 01 00 00 00 00 05 b1 02 5f 02 bf 
			29 01 00 00 00 00 07 b2 02 f6 03 34 03 57 
			29 01 00 00 00 00 02 6f 06 
			29 01 00 00 00 00 07 b2 03 86 03 8f 03 ac 
			29 01 00 00 00 00 02 6f 0c 
			29 01 00 00 00 00 05 b2 03 bd 03 e4 
			29 01 00 00 00 00 05 b3 03 f7 03 ff 
			29 01 00 00 00 00 06 f0 55 aa 52 08 06 
			29 01 00 00 00 00 03 b0 0b 2e 
			29 01 00 00 00 00 03 b1 2e 2e 
			29 01 00 00 00 00 03 b2 2e 09 
			29 01 00 00 00 00 03 b3 2a 
			29 29 01 00 00 00 00 03 b4 1b 19 
			29 01 00 00 00 00 03 b5 17 15 
			29 01 00 00 00 00 03 b6 13 11 
			29 01 00 00 00 00 03 b7 01 2e 
			29 01 00 00 00 00 03 b8 2e 2e 
			29 01 00 00 00 00 03 b9 2e 2e 
			29 01 00 00 00 00 03 ba 2e 2e 
			29 01 00 00 00 00 03 bb 2e 2e 
			29 01 00 00 00 00 03 bc 2e 00 
			29 01 00 00 00 00 03 bd 10 12 
			29 01 00 00 00 00 03 be 14 16 
			29 01 00 00 00 00 03 bf 18 1a 
			29 01 00 00 00 00 03 c0 29 2a 
			29 01 00 00 00 00 03 c1 08 2e 
			29 01 00 00 00 00 03 c2 2e 2e 
			29 01 00 00 00 00 03 c3 2e 0a 
			29 01 00 00 00 00 03 e5 2e 2e 
			29 01 00 00 00 00 03 c4 0a 2e 
			29 01 00 00 00 00 03 c5 2e 2e 
			29 01 00 00 00 00 03 c6 2e 00 
			29 01 00 00 00 00 03 c7 2a 29 
			29 01 00 00 00 00 03 c8 10 12 
			29 01 00 00 00 00 03 c9 14 16 
			29 01 00 00 00 00 03 ca 18 1a 
			29 01 00 00 00 00 03 cb 08 2e 
			29 01 00 00 00 00 03 cc 2e 2e 
			29 01 00 00 00 00 03 cd 2e 2e 
			29 01 00 00 00 00 03 ce 2e 2e 
			29 01 00 00 00 00 03 cf 2e 2e 
			29 01 00 00 00 00 03 d0 2e 09 29 01 00 00 00 00 03 d1 1b 19 29 01 00 00 00 00 03 d2 17 15 29 01 00 00 00 00 03 d3 13 11 29 01 00 00 00 00 03 d4 29 2a 29 01 00 00 00 00 03 d5 01 2e 29 01 00 00 00 00 03 d6 2e 2e 29 01 00 00 00 00 03 d7 2e 0b 29 01 00 00 00 00 03 e6 2e 2e 29 01 00 00 00 00 06 d8 00 00 00 00 00 29 01 00 00 00 00 06 d9 00 00 00 00 00 29 01 00 00 00 00 02 e7 00 29 01 00 00 00 00 06 f0 55 aa 52 08 03 29 01 00 00 00 00 03 b0 20 00 29 01 00 00 00 00 03 b1 20 00 29 01 00 00 00 00 06 b2 05 00 00 00 00 29 01 00 00 00 00 06 b6 05 00 00 00 00 29 01 00 00 00 00 06 b7 05 00 00 00 00 29 01 00 00 00 00 06 ba 57 00 00 00 00 29 01 00 00 00 00 06 bb 57 00 00 00 00 29 01 00 00 00 00 05 c0 00 00 00 00 29 01 00 00 00 00 05 c1 00 00 00 00 29 01 00 00 00 00 02 c4 60 29 01 00 00 00 00 02 c5 40 29 01 00 00 00 00 06 f0 55 aa 52 08 05 29 01 00 00 00 00 06 bd 03 01 03 03 03 29 01 00 00 00 00 03 b0 17 06 29 01 00 00 00 00 03 b1 17 06 29 01 00 00 00 00 03 b2 17 06 29 01 00 00 00 00 03 b3 17 06 29 01 00 00 00 00 03 b4 17 06 29 01 00 00 00 00 03 b5 17 06 29 01 00 00 00 00 02 b8 00 29 01 00 00 00 00 02 b9 00 29 01 00 00 00 00 02 ba 00 29 01 00 00 00 00 02 bb 02 29 01 00 00 00 00 02 bc 00 29 01 00 00 00 00 02 c0 07 29 01 00 00 00 00 02 c4 80 29 01 00 00 00 00 02 c5 a4 29 01 00 00 00 00 03 c8 05 30 29 01 00 00 00 00 03 c9 01 31 29 01 00 00 00 00 04 cc 00 00 3c 29 01 00 00 00 00 04 cd 00 00 3c 29 01 00 00 00 00 06 d1 00 05 09 07 10 29 01 00 00 00 00 06 d2 00 05 0e 07 10 29 01 00 00 00 00 02 e5 06 29 01 00 00 00 00 02 e6 06 29 01 00 00 00 00 02 e7 06 29 01 00 00 00 00 02 e8 06 29 01 00 00 00 00 02 e9 06 29 01 00 00 00 00 02 ea 06 29 01 00 00 00 00 02 ed 30 29 01 00 00 00 00 02 6f 11 29 01 00 00 00 00 
02 f3 01 29 01 00 00 00 00 02 51 ff 29 01 00 00 00 00 02 53 2c 29 01 00 00 00 00 02 35 00 05 01 00 00 78 00 02 11 00 05 01 00 00 14 00 02 29 00];
		qcom,mdss-dsi-off-command = [
			05 01 00 00 32 00 02 28 00 
			05 01 00 00 78 00 02 10 00
			];
		qcom,mdss-dsi-on-command-state = "dsi_lp_mode";
		qcom,mdss-dsi-off-command-state = "dsi_hs_mode";
		qcom,mdss-dsi-h-sync-pulse = <0x01>;
		qcom,mdss-dsi-traffic-mode = "burst_mode";
		qcom,mdss-dsi-lane-map = "lane_map_0123";
		qcom,mdss-dsi-bllp-eof-power-mode;
		qcom,mdss-dsi-bllp-power-mode;
		qcom,mdss-dsi-lane-0-state;
		qcom,mdss-dsi-lane-1-state;
		qcom,mdss-dsi-lane-2-state;
		qcom,mdss-dsi-lane-3-state;
		qcom,mdss-dsi-panel-timings = <0x871c1200 0x42441820 0x17030400>;
		qcom,mdss-dsi-t-clk-post = <0x04>;
		qcom,mdss-dsi-t-clk-pre = <0x1b>;
		qcom,mdss-dsi-bl-min-level = <0x01>;
		qcom,mdss-dsi-bl-max-level = <0xfff>;
		qcom,mdss-dsi-dma-trigger = "trigger_sw";
		qcom,mdss-dsi-mdp-trigger = "none";
		qcom,mdss-dsi-bl-pmic-control-type = "bl_ctrl_wled";
		qcom,mdss-dsi-reset-sequence = <0x01 0x14 0x00 0x02 0x01 0x14>;
	    };

};
