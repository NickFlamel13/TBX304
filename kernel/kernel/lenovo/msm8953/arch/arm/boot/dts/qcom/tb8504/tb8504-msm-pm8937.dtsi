&spmi_bus {
		 qcom,pm8937@0 {
				qcom,power-on@800 {
					/delete-property/ qcom,store-hard-reset-reason;
					 qcom,pon_1 {
						 qcom,support-reset = <1>;
						qcom,s1-timer = <6720>;
						 qcom,s2-timer = <2000>;
						 qcom,s2-type = <5>;
					};
				};
		};
};
