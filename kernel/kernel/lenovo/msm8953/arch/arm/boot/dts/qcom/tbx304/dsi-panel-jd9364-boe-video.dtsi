/* Copyright (c) 2015, The Linux Foundation. All rights reserved.
 *
 * This program is free software; you can redistribute it and/or modify
 * it under the terms of the GNU General Public License version 2 and
 * only version 2 as published by the Free Software Foundation.
 *
 * This program is distributed in the hope that it will be useful,
 * but WITHOUT ANY WARRANTY; without even the implied warranty of
 * MERCHANTABILITY or FITNESS FOR A PARTICULAR PURPOSE.  See the
 * GNU General Public License for more details.
 */

&mdss_mdp {
	mdss_dsi_jd9364_boe_video: qcom,mdss_dsi_jd9364_boe_video {
		qcom,mdss-dsi-panel-name = "mdss_dsi_jd9364_boe_video";
		qcom,mdss-dsi-panel-controller = <&mdss_dsi0>;
		qcom,mdss-dsi-panel-type = "dsi_video_mode";
		qcom,mdss-dsi-panel-destination = "display_1";
		qcom,mdss-dsi-panel-orientation = [30 00];
		qcom,mdss-dsi-panel-framerate = <0x3a>;
		qcom,mdss-dsi-virtual-channel-id = <0x00>;
		qcom,mdss-dsi-stream = <0x00>;
		qcom,mdss-dsi-panel-width = <0x320>;
		qcom,mdss-dsi-panel-height = <0x500>;
		qcom,mdss-dsi-h-front-porch = <0x28>;
		qcom,mdss-dsi-h-back-porch = <0x14>;
		qcom,mdss-dsi-h-pulse-width = <0x14>;
		qcom,mdss-dsi-h-sync-skew = <0x00>;
		qcom,mdss-dsi-v-back-porch = <0x08>;
		qcom,mdss-dsi-v-front-porch = <0x08>;
		qcom,mdss-dsi-v-pulse-width = <0x04>;
		qcom,mdss-dsi-h-left-border = <0x00>;
		qcom,mdss-dsi-h-right-border = <0x00>;
		qcom,mdss-dsi-v-top-border = <0x00>;
		qcom,mdss-dsi-v-bottom-border = <0x00>;
		qcom,mdss-dsi-bpp = <0x18>;
		qcom,mdss-dsi-color-order = "rgb_swap_rgb";
		qcom,mdss-dsi-underflow-color = <0xff>;
		qcom,mdss-dsi-border-color = <0x00>;
		qcom,mdss-dsi-on-command = [39 01 00 00 00 00 02 e0 00 39 01 00 00 00 00 02 e1 93 39 01 00 00 00 00 02 e2 65 39 01 00 00 00 00 02 e3 f8 39 01 00 00 00 00 02 80 03 39 01 00 00 00 00 02 e0 01 39 01 00 00 00 00 02 00 00 39 01 00 00 00 00 02 01 6f 39 01 00 00 00 00 02 03 00 39 01 00 00 00 00 02 04 6a 39 01 00 00 00 00 02 17 00 39 01 00 00 00 00 02 18 af 39 01 00 00 00 00 02 19 01 39 01 00 00 00 00 02 1a 00 39 01 00 00 00 00 02 1b af 39 01 00 00 00 00 02 1c 01 39 01 00 00 00 00 02 1f 3e 39 01 00 00 00 00 02 20 28 39 01 00 00 00 00 02 21 28 39 01 00 00 00 00 02 22 7e 39 01 00 00 00 00 02 35 26 39 01 00 00 00 00 02 37 05 39 01 00 00 00 00 02 38 04 39 01 00 00 00 00 02 39 00 39 01 00 00 00 00 02 3a 01 39 01 00 00 00 00 02 3c 7c 39 01 00 00 00 00 02 3d ff 39 01 00 00 00 00 02 3e ff 39 01 00 00 00 00 02 3f 7f 39 01 00 00 00 00 02 40 06 39 01 00 00 00 00 02 41 a0 39 01 00 00 00 00 02 42 81 39 01 00 00 00 00 02 43 08 39 01 00 00 00 00 02 44 0b 39 01 00 00 00 00 02 45 28 39 01 00 00 00 00 02 55 0f 39 01 00 00 00 00 02 57 69 39 01 00 00 00 00 02 59 0a 39 01 00 00 00 00 02 5a 28 39 01 00 00 00 00 02 5b 14 39 01 00 00 00 00 02 5d 7c 39 01 00 00 00 00 02 5e 65 39 01 00 00 00 00 02 5f 55 39 01 00 00 00 00 02 60 47 39 01 00 00 00 00 02 61 43 39 01 00 00 00 00 02 62 32 39 01 00 00 00 00 02 63 34 39 01 00 00 00 00 02 64 1c 39 01 00 00 00 00 02 65 33 39 01 00 00 00 00 02 66 31 39 01 00 00 00 00 02 67 30 39 01 00 00 00 00 02 68 4e 39 01 00 00 00 00 02 69 3c 39 01 00 00 00 00 02 6a 44 39 01 00 00 00 00 02 6b 35 39 01 00 00 00 00 02 6c 31 39 01 00 00 00 00 02 6d 23 39 01 00 00 00 00 02 6e 11 39 01 00 00 00 00 02 6f 00 39 01 00 00 00 00 02 70 7c 39 01 00 00 00 00 02 71 65 39 01 00 00 00 00 02 72 55 39 01 00 00 00 00 02 73 47 39 01 00 00 00 00 02 74 43 39 01 00 00 00 00 02 75 32 39 01 00 00 00 00 02 76 34 39 01 00 00 00 00 02 77 1c 39 01 00 00 00 00 02 78 33 39 01 00 00 00 00 02 79 31 39 01 00 00 00 00 02 7a 30 39 01 00 00 00 00 02 7b 4e 39 01 00 00 00 00 02 7c 3c 39 01 00 00 00 00 02 7d 44 39 01 00 00 00 00 02 7e 35 39 01 00 00 00 00 02 7f 31 39 01 00 00 00 00 02 80 23 39 01 00 00 00 00 02 81 11 39 01 00 00 00 00 02 82 00 39 01 00 00 00 00 02 e0 02 39 01 00 00 00 00 02 00 1e 39 01 00 00 00 00 02 01 1e 39 01 00 00 00 00 02 02 41 39 01 00 00 00 00 02 03 41 39 01 00 00 00 00 02 04 1f 39 01 00 00 00 00 02 05 1f 39 01 00 00 00 00 02 06 1f 39 01 00 00 00 00 02 07 1f 39 01 00 00 00 00 02 08 1f 39 01 00 00 00 00 02 09 1f 39 01 00 00 00 00 02 0a 1e 39 01 00 00 00 00 02 0b 1e 39 01 00 00 00 00 02 0c 1f 39 01 00 00 00 00 02 0d 47 39 01 00 00 00 00 02 0e 47 39 01 00 00 00 00 02 0f 45 39 01 00 00 00 00 02 10 45 39 01 00 00 00 00 02 11 4b 39 01 00 00 00 00 02 12 4b 39 01 00 00 00 00 02 13 49 39 01 00 00 00 00 02 14 49 39 01 00 00 00 00 02 15 1f 39 01 00 00 00 00 02 16 1e 39 01 00 00 00 00 02 17 1e 39 01 00 00 00 00 02 18 40 39 01 00 00 00 00 02 19 40 39 01 00 00 00 00 02 1a 1f 39 01 00 00 00 00 02 1b 1f 39 01 00 00 00 00 02 1c 1f 39 01 00 00 00 00 02 1d 1f 39 01 00 00 00 00 02 1e 1f 39 01 00 00 00 00 02 1f 1f 39 01 00 00 00 00 02 20 1e 39 01 00 00 00 00 02 21 1e 39 01 00 00 00 00 02 22 1f 39 01 00 00 00 00 02 23 46 39 01 00 00 00 00 02 24 46 39 01 00 00 00 00 02 25 44 39 01 00 00 00 00 02 26 44 39 01 00 00 00 00 02 27 4a 39 01 00 00 00 00 02 28 4a 39 01 00 00 00 00 02 29 48 39 01 00 00 00 00 02 2a 48 39 01 00 00 00 00 02 2b 1f 39 01 00 00 00 00 02 2c 1f 39 01 00 00 00 00 02 2d 1f 39 01 00 00 00 00 02 2e 40 39 01 00 00 00 00 02 2f 40 39 01 00 00 00 00 02 30 1f 39 01 00 00 00 00 02 31 1f 39 01 00 00 00 00 02 32 1e 39 01 00 00 00 00 02 33 1e 39 01 00 00 00 00 02 34 1f 39 01 00 00 00 00 02 35 1f 39 01 00 00 00 00 02 36 1e 39 01 00 00 00 00 02 37 1e 39 01 00 00 00 00 02 38 1f 39 01 00 00 00 00 02 39 48 39 01 00 00 00 00 02 3a 48 39 01 00 00 00 00 02 3b 4a 39 01 00 00 00 00 02 3c 4a 39 01 00 00 00 00 02 3d 44 39 01 00 00 00 00 02 3e 44 39 01 00 00 00 00 02 3f 46 39 01 00 00 00 00 02 40 46 39 01 00 00 00 00 02 41 1f 39 01 00 00 00 00 02 42 1f 39 01 00 00 00 00 02 43 1f 39 01 00 00 00 00 02 44 41 39 01 00 00 00 00 02 45 41 39 01 00 00 00 00 02 46 1f 39 01 00 00 
00 00 02 47 1f 39 01 00 00 00 00 02 48 1e 39 01 00 00 00 00 02 49 1e 39 01 00 00 00 00 02 4a 1e 39 01 00 00 00 00 02 4b 1f 39 01 00 00 00 00 02 4c 1e 39 01 00 00 00 00 02 4d 1e 39 01 00 00 00 00 02 4e 1f 39 01 00 00 00 00 02 4f 49 39 01 00 00 00 00 02 50 49 39 01 00 00 00 00 02 51 4b 39 01 00 00 00 00 02 52 4b 39 01 00 00 00 00 02 53 45 39 01 00 00 00 00 02 54 45 39 01 00 00 00 00 02 55 47 39 01 00 00 00 00 02 56 47 39 01 00 00 00 00 02 57 1f 39 01 00 00 00 00 02 58 40 39 01 00 00 00 00 02 5b 30 39 01 00 00 00 00 02 5c 03 39 01 00 00 00 00 02 5d 30 39 01 00 00 00 00 02 5e 01 39 01 00 00 00 00 02 5f 02 39 01 00 00 00 00 02 63 14 39 01 00 00 00 00 02 64 6a 39 01 00 00 00 00 02 67 73 39 01 00 00 00 00 02 68 05 39 01 00 00 00 00 02 69 14 39 01 00 00 00 00 02 6a 6a 39 01 00 00 00 00 02 6b 08 39 01 00 00 00 00 02 6c 00 39 01 00 00 00 00 02 6d 00 39 01 00 00 00 00 02 6e 00 39 01 00 00 00 00 02 6f 88 39 01 00 00 00 00 02 77 dd 39 01 00 00 00 00 02 79 0e 39 01 00 00 00 00 02 7a 03 39 01 00 00 00 00 02 7d 14 39 01 00 00 00 00 02 7e 6a 39 01 00 00 00 00 02 e0 03 39 01 00 00 00 00 02 af 20 39 01 00 00 00 00 02 a0 33 39 01 00 00 00 00 02 a9 81 39 01 00 00 00 00 02 e0 04 39 01 00 00 00 00 02 09 11 39 01 00 00 00 00 02 0e 48 39 01 00 00 00 00 02 2b 2b 39 01 00 00 00 00 02 2d 03 39 01 00 00 00 00 02 2e 44 39 01 00 00 00 00 02 41 ff 39 01 00 00 00 00 02 e0 00 39 01 00 00 00 00 02 e6 02 39 01 00 00 00 00 02 e7 0c 39 01 00 00 00 00 02 35 00 05 01 00 00 78 00 02 11 00 05 01 00 00 14 00 02 29 00];
		qcom,mdss-dsi-off-command = [39 01 00 00 01 00 02 e0 00 39 01 00 00 00 00 02 e1 93 39 01 00 00 00 00 02 e2 65 39 01 00 00 00 00 02 e3 f8 39 01 00 00 32 00 02 28 00 39 01 00 00 78 00 02 10 00];
		qcom,mdss-dsi-on-command-state = "dsi_lp_mode";
		qcom,mdss-dsi-off-command-state = "dsi_lp_mode";
		qcom,mdss-dsi-h-sync-pulse = <0x01>;
		qcom,mdss-dsi-traffic-mode = "burst_mode";
		qcom,mdss-dsi-lane-map = "lane_map_0123";
		qcom,mdss-dsi-bllp-eof-power-mode;
		qcom,mdss-dsi-bllp-power-mode;
		qcom,mdss-dsi-lane-0-state;
		qcom,mdss-dsi-lane-1-state;
		qcom,mdss-dsi-lane-2-state;
		qcom,mdss-dsi-lane-3-state;
		qcom,mdss-dsi-panel-timings = <0x8b1e1400 0x44481822 0x19030400>;
		qcom,mdss-dsi-t-clk-post = <0x04>;
		qcom,mdss-dsi-t-clk-pre = <0x1c>;
		qcom,mdss-dsi-bl-min-level = <0x01>;
		qcom,mdss-dsi-bl-max-level = <0xfff>;
		qcom,mdss-dsi-dma-trigger = "trigger_sw";
		qcom,mdss-dsi-mdp-trigger = "none";
		qcom,mdss-dsi-bl-pmic-control-type = "bl_ctrl_wled";
		qcom,mdss-dsi-reset-sequence = <0x01 0x14 0x00 0x06 0x01 0x14>;
	    };

};
