/* Copyright (c) 2015-2016, 2018, The Linux Foundation. All rights reserved.
 *
 * This program is free software; you can redistribute it and/or modify
 * it under the terms of the GNU General Public License version 2 and
 * only version 2 as published by the Free Software Foundation.
 *
 * This program is distributed in the hope that it will be useful,
 * but WITHOUT ANY WARRANTY; without even the implied warranty of
 * MERCHANTABILITY or FITNESS FOR A PARTICULAR PURPOSE.  See the
 * GNU General Public License for more details.
 */

&mdss_mdp {
	dsi_ft8201_720p_video: qcom,mdss_dsi_ft8201_720p_video {
		qcom,mdss-dsi-panel-name = "boe ft8201_720p video mode dsi panel";
		qcom,mdss-dsi-panel-type = "dsi_video_mode";
		qcom,mdss-dsi-panel-controller = <&mdss_dsi0>;
		qcom,mdss-dsi-panel-destination = "display_3";
		qcom,mdss-dsi-panel-framerate = <60>;
		qcom,mdss-dsi-virtual-channel-id = <0>;
		qcom,mdss-dsi-stream = <0>;
		qcom,mdss-dsi-panel-width = <800>;
		qcom,mdss-dsi-panel-height = <1280>;
		qcom,mdss-pan-physical-width-dimension = <64>;
		qcom,mdss-pan-physical-height-dimension = <135>;
		qcom,mdss-dsi-h-front-porch = <170>;
		qcom,mdss-dsi-h-back-porch = <60>;
		qcom,mdss-dsi-h-pulse-width = <14>;
		qcom,mdss-dsi-h-sync-skew = <0>;
		qcom,mdss-dsi-v-back-porch = <32>;
		qcom,mdss-dsi-v-front-porch = <184>;
		qcom,mdss-dsi-v-pulse-width = <8>;
		qcom,mdss-dsi-h-left-border = <0>;
		qcom,mdss-dsi-h-right-border = <0>;
		qcom,mdss-dsi-v-top-border = <0>;
		qcom,mdss-dsi-v-bottom-border = <0>;
		qcom,mdss-dsi-bpp = <24>;
		qcom,mdss-dsi-underflow-color = <0xff>;
		qcom,mdss-dsi-border-color = <0>;
		qcom,mdss-dsi-h-sync-pulse = <0>;
		qcom,mdss-dsi-traffic-mode = "burst_mode";
		qcom,mdss-dsi-bllp-eof-power-mode;
		qcom,mdss-dsi-bllp-power-mode;
		qcom,mdss-dsi-lane-0-state;
		qcom,mdss-dsi-lane-1-state;
		qcom,mdss-dsi-lane-2-state;
		qcom,mdss-dsi-lane-3-state;
		qcom,mdss-dsi-panel-timings = [9B 22 18 00 4A 4E 1C 26 1E 03 04 00];

		qcom,mdss-dsi-t-clk-post = <0x04>;
		qcom,mdss-dsi-t-clk-pre = <0x1b>;
		qcom,mdss-dsi-bl-min-level = <50>;
		qcom,mdss-dsi-bl-max-level = <4095>;
		qcom,mdss-dsi-dma-trigger = "trigger_sw";
		qcom,mdss-dsi-mdp-trigger = "none";
		qcom,mdss-dsi-on-command = [
		05 01 00 00 A0 00 02 11 00      
		39 01 00 00 00 00 03 50 5A 0E
		39 01 00 00 00 00 04 83 AC B4 6D		          
		39 01 00 00 00 00 03 50 5A 19
		39 01 00 00 00 00 05 8C 77 F7 FB FF
		39 01 00 00 00 00 08 90 FF FF 80 C4 AF 8F 0D
		39 01 00 00 00 00 03 A1 0F 42 
		39 01 00 00 00 00 03 50 5A 23
		39 01 00 00 00 00 03 90 00 00
		39 01 00 00 00 00 03 94 2C 00		 
		05 01 00 00 0A 00 02 29 00];
		qcom,mdss-dsi-off-command = [
			05 01 00 00 14 00 01 28
			05 01 00 00 A0 00 01 10];
		qcom,mdss-dsi-on-command-state = "dsi_lp_mode";
		qcom,mdss-dsi-off-command-state = "dsi_lp_mode";
		qcom,mdss-dsi-bl-pmic-control-type = "bl_ctrl_dcs";
		qcom,mdss-dsi-reset-sequence = <1 10>, <0 10>, <1 50>;
		qcom,mdss-dsi-tx-eot-append;
		qcom,mdss-dsi-lp11-init;
		qcom,mdss-dsi-post-init-delay = <1>;
		qcom,panel-supply-entries = <&dsi_panel_pwr_supply_ft8201>;
	};
};
