/*
 * Copyright (c) 2015-2016, The Linux Foundation. All rights reserved.
 *
 * This program is free software; you can redistribute it and/or modify
 * it under the terms of the GNU General Public License version 2 and
 * only version 2 as published by the Free Software Foundation.
 *
 * This program is distributed in the hope that it will be useful,
 * but WITHOUT ANY WARRANTY; without even the implied warranty of
 * MERCHANTABILITY or FITNESS FOR A PARTICULAR PURPOSE.  See the
 * GNU General Public License for more details.
 */

&int_codec {
	qcom,audio-routing = 
		"RX_BIAS", "MCLK",
		"SPK_RX_BIAS", "MCLK",
		"INT_LDO_H", "MCLK",
		"MIC BIAS Internal1", "Handset Mic",
		"MIC BIAS Internal2", "Headset Mic",
		"MIC BIAS External", "Secondary Mic",
		"AMIC1", "MIC BIAS Internal1",
		"AMIC2", "MIC BIAS Internal2",
		"AMIC3", "MIC BIAS External";
	qcom,msm-gpios = 
		"pri_i2s",
		"us_eu_gpio",
		"quin_i2s";
	qcom,pinctrl-names = 
		"all_off",
		"pri_i2s_act",
		"us_eu_gpio_act",
		"pri_i2s_us_eu_gpio_act",
		"quin_act",
		"quin_pri_i2s_act",
		"quin_us_eu_gpio_act",
		"quin_us_eu_gpio_pri_i2s_act";

	pinctrl-names = 
		"all_off",
		"pri_i2s_act",
		"us_eu_gpio_act",
		"pri_i2s_us_eu_gpio_act",
		"quin_act",
		"quin_pri_i2s_act",
		"quin_us_eu_gpio_act",
		"quin_us_eu_gpio_pri_i2s_act";

        pinctrl-0 = <&cdc_pdm_lines_sus
                        &cdc_pdm_lines_2_sus &cross_conn_det_sus
                        &pri_tlmm_lines_sus &pri_tlmm_ws_sus>;
        pinctrl-1 = <&cdc_pdm_lines_act
                        &cdc_pdm_lines_2_act &cross_conn_det_sus
                        &pri_tlmm_lines_sus &pri_tlmm_ws_sus>;
        pinctrl-2 = <&cdc_pdm_lines_sus
                        &cdc_pdm_lines_2_sus &cross_conn_det_act
                        &pri_tlmm_lines_sus &pri_tlmm_ws_sus>;
        pinctrl-3 = <&cdc_pdm_lines_act
                        &cdc_pdm_lines_2_act &cross_conn_det_act
                        &pri_tlmm_lines_sus &pri_tlmm_ws_sus>;
        pinctrl-4 = <&cdc_pdm_lines_sus
                        &cdc_pdm_lines_2_sus &cross_conn_det_sus
                        &pri_tlmm_lines_act &pri_tlmm_ws_act>;
        pinctrl-5 = <&cdc_pdm_lines_act
                        &cdc_pdm_lines_2_act &cross_conn_det_sus
                        &pri_tlmm_lines_act &pri_tlmm_ws_act>;
        pinctrl-6 = <&cdc_pdm_lines_sus
                        &cdc_pdm_lines_2_sus &cross_conn_det_act
                        &pri_tlmm_lines_act &pri_tlmm_ws_act>;
        pinctrl-7 = <&cdc_pdm_lines_act
                        &cdc_pdm_lines_2_act &cross_conn_det_act
                        &pri_tlmm_lines_act &pri_tlmm_ws_act>;

	qcom,msm-spk-ext-pa = <&tlmm 68 0>;
	qcom,msm-spk-ext-pa1 = <&tlmm 62 0>;
	qcom,cdc-us-euro-gpios = <&tlmm 45 0>;

};


