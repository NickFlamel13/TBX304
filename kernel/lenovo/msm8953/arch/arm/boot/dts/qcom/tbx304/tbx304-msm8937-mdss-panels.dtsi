#include "dsi-panel-jd9364-boe-video.dtsi"
#include "dsi-panel-nt35521s-boe-wxga-video.dtsi"
#include "dsi-panel-nt35521s-wxga-video.dtsi"

&mdss_dsi0 {
    qcom,platform-enable-gpio = <&tlmm 46 0>;
};

