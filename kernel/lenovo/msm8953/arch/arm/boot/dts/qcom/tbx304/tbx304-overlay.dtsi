#include "tbx304-msm8917.dtsi"
#include "tbx304-msm8917-pinctrl.dtsi"
#include "tbx304-msm8937.dtsi"
#include "tbx304-msm8917-camera-sensor-qrd.dtsi"
#include "tbx304-msm8937-mdss-panels.dtsi"
#include "tbx304-msm8917-pmi8937-qrd-sku5.dtsi"
#include "tbx304-msm8917-audio.dtsi"
#include "tbx304-msm-pmi8937.dtsi"
#include "tbx304-msm8917-regulator.dtsi"
#include "tbx304-msm-pm8937.dtsi"
