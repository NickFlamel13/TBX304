## kernel/lenovo/msm8953/drivers/input/touchscreen/hxchipset_tb8504/Kconfig
```kconfig
#
# Himax Touchscreen driver configuration
#

config TOUCHSCREEN_HIMAX_TB8504_I2C
        tristate "HIMAX chipset i2c touchscreen"
		depends on TOUCHSCREEN_HIMAX_TB8504_CHIPSET
		help
		This enables support for HIMAX CHIPSET over I2C based touchscreens.

config TOUCHSCREEN_HIMAX_TB8504_DEBUG
        tristate "HIMAX debug function"
		depends on TOUCHSCREEN_HIMAX_TB8504_I2C
		help
		This enables support for HIMAX debug function.
config HMX_TB8504_DB
	tristate "HIMAX driver test over Dragon Board"
	depends on TOUCHSCREEN_HIMAX_TB8504_I2C
	help
	  This enables support for HIMAX driver test over Dragon Board.
```
